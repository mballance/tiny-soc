## sw/zephyr/boards/riscv/tiny_soc_brd/tiny_soc_brd_defconfig
```kconfig
CONFIG_BOARD_TINY_SOC_BRD=y
CONFIG_CONSOLE=y
CONFIG_PRINTK=y
CONFIG_SERIAL=n
CONFIG_UART_CONSOLE=n
CONFIG_RAM_CONSOLE=y
CONFIG_BOOT_BANNER=y
CONFIG_FW_PIT=y
CONFIG_FW_PERIPH_DMA=y

CONFIG_XIP=n
CONFIG_SYS_CLOCK_EXISTS=y
```

## sw/zephyr/soc/riscv/tiny_soc/Kconfig.defconfig
```kconfig
if SOC_TINY_SOC


config SOC
	string
	default "tiny_soc"
	
config SYS_CLOCK_HW_CYCLES_PER_SEC
	int
	default 16000000
	
config RISCV_SOC_INTERRUPT_INIT
	bool
	default y
	
config NUM_IRQS
	int
	default 8
	
endif # SOC_TINY_SOC
```

## sw/zephyr/soc/riscv/tiny_soc/Kconfig.soc
```kconfig
config SOC_TINY_SOC
	bool "tiny_soc SoC"
	select RISCV
	select ATOMIC_OPERATIONS_C
		
```
